/*
 * Copyright (c) 2020 The ZMK Contributors
 *
 * SPDX-License-Identifier: MIT
 */

#include <behaviors.dtsi>
#include <dt-bindings/zmk/keys.h>
#include <dt-bindings/zmk/bt.h>
// #include <dt-bindings/zmk/pointing.h>

#define BASE 0
#define LOWER 1
#define MOUSE_KEYS 2
#define MOUSE_TP 3
#define MOUSE_TP_SET 4

/*
 * Defines to enable/disable features
 *
 * These defines allow us to conditionally enable and disable parts of the keymap config.
 *
 * For example, if we decide to build the firmware without the mouse features, we can
 * disable all the config options that rely on those forks and modules without having
 * to edit the entire keymap file manually every time.
 */

#define HAS_MOUSE_KEYS
#define HAS_MOUSE_TP

#ifdef HAS_MOUSE_KEYS
  #include <dt-bindings/zmk/mouse.h>
  #include <behaviors/mouse_keys.dtsi>
#endif  // HAS_MOUSE_KEYS

#ifdef HAS_MOUSE_TP
  // We store the trackpoint settings in a separate file
  // to make organization a little easier.
  #include "include/mouse_tp.dtsi"
#endif  // HAS_MOUSE_TP



// Adjust layer keys based on enabled features.
//
// This prevents build errors when we build the firmware
// without the mouse keys PR or the TP module.
#ifdef HAS_MOUSE_KEYS
  #define U_THUMB_INNER &mo MOUSE_KEYS
#else
  #define U_THUMB_INNER &none
#endif  // HAS_MOUSE_KEYS

#ifdef HAS_MOUSE_TP
  #define U_TOG_TP_SET &tog MOUSE_TP_SET
#else
  #define U_TOG_TP_SET &none
#endif  // HAS_MOUSE_TP

// Disable line-wrap in your editor to see a "visualization" of the key layouts

/ {
    macros {
        change_lang: change_lang {
            compatible = "zmk,behavior-macro";
            #binding-cells = <0>;
            bindings =
                <&macro_press>,
                <&kp LSHIFT>,
                <&macro_tap>,
                <&kp LALT>,
                <&macro_release>,
                <&kp LSHFT>;

            label = "change_lang";
        };

        ps: ps {
            compatible = "zmk,behavior-macro";
            #binding-cells = <0>;
            bindings = <&kp LS(F) &kp LS(F) &kp LS(E) &kp LS(N) &kp O &kp W &kp LS(C) &kp N1 &kp F &kp ENTER>;
            label = "PS";
        };
    };

    combos {
        compatible = "zmk,combos";

        lang {
            bindings = <&change_lang>;
            key-positions = <15 16>;
        };

        esc {
            bindings = <&kp ESCAPE>;
            key-positions = <19 20 21>;
        };

        mouse_left {
            bindings = <&mkp LCLK>;
            key-positions = <7 8>;
        };

        mouse_right {
            bindings = <&mkp RCLK>;
            key-positions = <8 9>;
        };
    };

    keymap {
        compatible = "zmk,keymap";

        layer_0 {
            bindings = <
&kp TAB     &kp Q  &kp W  &kp E     &kp R               &kp T        &kp Y      &kp U               &kp I      &kp O       &kp P     &kp BSPC
&kp LSHIFT  &kp A  &kp S  &kp D     &kp F               &kp G        &kp H      &kp J               &kp K      &mt RALT L  &kp SEMI  &kp APOS
&kp LCTRL   &kp Z  &kp X  &kp C     &kp V               &kp B        &kp N      &kp M               &kp COMMA  &kp DOT     &kp FSLH  &kp LBKT
                          &kp LGUI  &lt 1 LEFT_CONTROL  &kp ENTER    &kp SPACE  &lt 2 LEFT_CONTROL  &kp RALT
            >;
        };

        layer_1 {
            bindings = <
&kp TAB    &kp EXCLAMATION  &kp AT_SIGN  &kp HASH  &kp DOLLAR  &kp PERCENT    &kp CARET             &kp AMPERSAND       &kp ASTERISK  &kp LEFT_PARENTHESIS  &kp RIGHT_PARENTHESIS  &trans
&kp LSHFT  &kp N1           &kp N2       &kp N3    &kp N4      &kp N5         &kp NON_US_BACKSLASH  &kp EQUAL           &kp PLUS      &kp LEFT_BRACKET      &kp RIGHT_BRACKET      &trans
&kp RCTRL  &kp N6           &kp N7       &kp N8    &kp N9      &kp N0         &kp SLASH             &kp UNDERSCORE      &kp MINUS     &kp LEFT_BRACE        &kp RIGHT_BRACE        &ps
                                         &trans    &trans      &trans         &trans                &lt 3 LEFT_CONTROL  &trans
            >;
        };

        layer_2 {
            bindings = <
&kp TAB    &kp F1    &kp F2    &kp F3                   &kp F4                   &kp F5              &kp F6           &kp F7      &kp F8        &kp F9           &kp F10  &trans
&kp LSHFT  &kp F11   &kp F12   &mt LEFT_CONTROL C_MUTE  &mt LEFT_SHIFT C_VOL_UP  &kp C_VOL_DN        &kp LEFT         &kp DOWN    &kp UP_ARROW  &kp RIGHT_ARROW  &kp END  &trans
&kp RCTRL  &kp LALT  &kp LGUI  &kp C_PREV               &kp C_NEXT               &kp C_PLAY_PAUSE    &kp PAUSE_BREAK  &kp DELETE  &kp PAGE_UP   &kp PAGE_DOWN    &kp Z    &trans
                               &trans                   &trans                   &trans              &trans           &trans      &trans
            >;
        };

        layer_3 {
            bindings = <
&trans  &trans  &trans  &bt BT_CLR  &trans      &trans    &trans  &trans  &trans  &trans  &trans  &trans
&trans  &trans  &trans  &bt BT_NXT  &bt BT_PRV  &trans    &trans  &trans  &trans  &trans  &trans  &trans
&trans  &trans  &trans  &trans      &trans      &trans    &trans  &trans  &trans  &trans  &trans  &trans
                        &trans      &trans      &trans    &trans  &trans  &trans
            >;
        };
    };
};
        };
    };
};
